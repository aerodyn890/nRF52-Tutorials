## LED-Control/boards/arm/roverdyn_nrf52dk_52810/Kconfig.board
```kconfig
# Copyright (c) 2024 Nordic Semiconductor ASA
# SPDX-License-Identifier: Apache-2.0

config BOARD_ROVERDYN_NRF52DK_52810
	bool "Roverdyn nRF52DK-52810"
	depends on SOC_NRF52810_QFAA
```

## LED-Control/boards/arm/roverdyn_nrf52dk_52810/Kconfig.defconfig
```kconfig
# Copyright (c) 2024 Nordic Semiconductor ASA
# SPDX-License-Identifier: Apache-2.0

if BOARD_ROVERDYN_NRF52DK_52810

config BOARD
	default "roverdyn_nrf52dk_52810"

config BT_CTLR
   default BT

endif
```

## LED-Control/boards/arm/roverdyn_nrf52dk_52832/Kconfig.board
```kconfig
# Copyright (c) 2024 Nordic Semiconductor ASA
# SPDX-License-Identifier: Apache-2.0

config BOARD_ROVERDYN_NRF52DK_52832
	bool "Roverdyn nRF52DK-52832"
	depends on SOC_NRF52832_QFAA
```

## LED-Control/boards/arm/roverdyn_nrf52dk_52832/Kconfig.defconfig
```kconfig
# Copyright (c) 2024 Nordic Semiconductor ASA
# SPDX-License-Identifier: Apache-2.0

if BOARD_ROVERDYN_NRF52DK_52832

config BOARD
	default "roverdyn_nrf52dk_52832"

config BT_CTLR
   default BT

endif
```

## UARTE-USB-Example/boards/arm/nrf52_devboard_52832/Kconfig.board
```kconfig
# Copyright (c) 2024 Nordic Semiconductor ASA
# SPDX-License-Identifier: Apache-2.0

config BOARD_NRF52_DEVBOARD_52832
	bool "nRF52-Devboard-52832"
	depends on SOC_NRF52832_QFAA
```

## UARTE-USB-Example/boards/arm/nrf52_devboard_52832/Kconfig.defconfig
```kconfig
# Copyright (c) 2024 Nordic Semiconductor ASA
# SPDX-License-Identifier: Apache-2.0

if BOARD_NRF52_DEVBOARD_52832

config BOARD
	default "nrf52_devboard_52832"

config BT_CTLR
   default BT


endif
```
